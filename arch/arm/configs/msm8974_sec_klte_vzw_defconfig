## arch/arm/configs/msm8974_sec_klte_vzw_defconfig
```kconfig
# K PROJECT config
CONFIG_ARCH_MSM8974PRO=y
CONFIG_SEC_K_PROJECT=y
CONFIG_MACH_KLTE_VZW=y
CONFIG_MSM_L2_ERP_PORT_PANIC=y
CONFIG_WLAN_REGION_CODE=100
CONFIG_H_EUR_WIFI=y
```
